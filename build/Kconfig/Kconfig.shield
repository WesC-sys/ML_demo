## build/Kconfig/Kconfig.shield
```kconfig
osource "c:/nordic/myapps/blinky_tutorial/boards/shields/*/Kconfig.shield"
osource "c:/nordic/myapps/peripheral_lbs_1/boards/shields/*/Kconfig.shield"
osource "C:/ncs/main/nrf/boards/shields/*/Kconfig.shield"
```

## build/Kconfig/Kconfig.shield.defconfig
```kconfig
osource "c:/nordic/myapps/blinky_tutorial/boards/shields/*/Kconfig.defconfig"
osource "c:/nordic/myapps/peripheral_lbs_1/boards/shields/*/Kconfig.defconfig"
osource "C:/ncs/main/nrf/boards/shields/*/Kconfig.defconfig"
```

## build/Kconfig/Kconfig.sysbuild.modules
```kconfig
menu "nrf (C:/ncs/main/nrf)"
osource "C:/ncs/main/nrf/sysbuild/Kconfig.sysbuild"
config ZEPHYR_NRF_MODULE
	bool
	default y
endmenu
```

## sample.yaml
```yaml
sample:
  name: Machine Learning demo
  description: Machine learning application demonstrator
tests:
  applications.machine_learning.zdebug:
    build_only: true
    platform_allow: >
      thingy53_nrf5340_cpuapp thingy53_nrf5340_cpuapp_ns
    integration_platforms:
      - thingy53_nrf5340_cpuapp
      - thingy53_nrf5340_cpuapp_ns
    tags: ci_build
  applications.machine_learning.zdebug_rtt:
    build_only: true
    platform_allow: thingy53_nrf5340_cpuapp thingy53_nrf5340_cpuapp_ns
    integration_platforms:
      - thingy53_nrf5340_cpuapp
      - thingy53_nrf5340_cpuapp_ns
    tags: ci_build
    extra_args: CONF_FILE=prj_rtt.conf
  applications.machine_learning.zrelease:
    build_only: true
    platform_allow: thingy53_nrf5340_cpuapp thingy53_nrf5340_cpuapp_ns
    integration_platforms:
      - thingy53_nrf5340_cpuapp
      - thingy53_nrf5340_cpuapp_ns
    tags: ci_build
    extra_args: CONF_FILE=prj_release.conf
```
